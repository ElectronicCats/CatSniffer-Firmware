## SAMD21/catsniffer/boards/catsniffer_v2/Kconfig.catsniffer_v2
```kconfig
# Copyright (c) 2026 Electronic Cats
# SPDX-License-Identifier: Apache-2.0

config BOARD_CATSNIFFER_V2
	select SOC_SAMD21E17A
```

## SAMD21/catsniffer/boards/catsniffer_v2/Kconfig.defconfig
```kconfig
# Copyright (c) 2026 Electronic Cats
# SPDX-License-Identifier: Apache-2.0

if BOARD_CATSNIFFER_V2

config BOARD
	default "catsniffer_v2"

config SYS_CLOCK_HW_CYCLES_PER_SEC
	default 48000000

endif # BOARD_CATSNIFFER_V2
```

## SAMD21/catsniffer/boards/catsniffer_v2/board.yml
```yaml
board:
  name: catsniffer_v2
  full_name: CatSniffer v2 (SAMD21)
  vendor: electroniccats
  socs:
    - name: samd21e17a
```
